## src/modules/robosub/rs_canfd_status/Kconfig
```kconfig
menuconfig MODULES_ROBOSUB_RS_CANFD_STATUS
	bool "CAN FD Status Module"
	default n
	---help---
		Enable support for robosub_CANFD_STATUS

menuconfig USER_ROBOSUB_RS_CANFD_STATUS
	bool "robosub_CANFD_STATUS running as userspace module"
	default y
	depends on BOARD_PROTECTED && MODULES_ROBOSUB_RS_CANFD_STATUS
	---help---
		Put robosub_CANFD_STATUS in userspace memory
```

## src/modules/robosub/rs_status_monitor/Kconfig
```kconfig
menuconfig MODULES_ROBOSUB_RS_STATUS_MONITOR
	bool "robosub_status_monitor"
	default n
	---help---
		Enable support for robosub_status_monitor

menuconfig USER_ROBOSUB_RS_STATUS_MONITOR
	bool "robosub_status_monitor running as userspace module"
	default y
	depends on BOARD_PROTECTED && MODULES_ROBOSUB_RS_STATUS_MONITOR
	---help---
		Put robosub_status_monitor in userspace memory
```
